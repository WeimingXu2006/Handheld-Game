#include <Adafruit_NeoMatrix.h>
#include <Adafruit_NeoPixel.h>
#include <avr/pgmspace.h> 
#define PIN 2 
#define left 3
#define down 5
#define up 4
#define right 6
int8_t levelplace=0;
int8_t place=0;
int8_t x=2;
int8_t y=2;
int8_t temp=0;
int8_t win[]={0,0,0,0,0,0,0,0,0,0,0,0,0,0,0,0,0,0,0,0,0,0,0,0,0,0,0,0};
int8_t pos=0;
int8_t oldpos=0;
const int8_t check[]={4,12,20,28};
int8_t goal=0;
//<0-level,0-blank,1-player,2-wall,3-box,4-player on goal,5-goal,6-box on goal,7-next menu,8-level(recursion),9-level on goal
int8_t screen[64]=
  {0,0,0,0,0,0,0,0,
   0,0,0,0,0,0,0,0,
   0,0,0,0,0,0,0,0,
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   0,0,0,0,0,0,0,0
};
int8_t menu=0;
int8_t level=0;
int8_t menus[][64]={
  {2,2,2,2,2,2,2,2,
   2,1,0,0,0,0,0,2,
   2,0,-1,0,0,-2,0,2,
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   2,2,2,2,2,2,2,2},
};
const PROGMEM int8_t levels[41][64]={
  {2,2,2,2,2,2,2,2,
   2,1,0,0,0,0,0,2,
   2,0,0,0,0,0,0,2,
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   2,2,2,2,5,2,2,2}//28
};

Adafruit_NeoMatrix matrix = Adafruit_NeoMatrix(8, 8, PIN,
  NEO_MATRIX_TOP     + NEO_MATRIX_RIGHT +
  NEO_MATRIX_COLUMNS + NEO_MATRIX_PROGRESSIVE,
  NEO_GRB            + NEO_KHZ800);

int8_t findSpace(int8_t state){
  for (int i=0;i<64;i++){
    if (screen[i]==state){
      pos=i;
    }
  }
  return pos;
}
  
int8_t newScreen(int8_t slide){
  if (level==0){
    for (int i=0;i<64;i++){
      screen[i]=menus[menu][i];
    }
  }else{
    for (int i=0;i<64;i++){
      screen[i]=pgm_read_byte(&(levels[slide][i]));
    }
  }
};

int8_t printScreen(int8_t slide[]){
  for (int i=0;i<64;i++){
    temp=pgm_read_byte(&(levels[level][i]));
    if ((temp==4)or(temp==5)or(temp==6)or(temp==9)){
      if (slide[i]==1){
        slide[i]=4;
      }else if (slide[i]==0){
        slide[i]=5;
      }else if (slide[i]==3){
        slide[i]=6;
      }else if (slide[i]==8){
        slide[i]=9;
      }
    }
    if (slide[i]==0){
      matrix.drawPixel(i%8,i/8,0x0000);
    }else if (slide[i]==1){
      matrix.drawPixel(i%8,i/8,0x90F5);
    }else if (slide[i]==2){
      matrix.drawPixel(i%8,i/8,0x0F55);
    }else if (slide[i]==3){
      matrix.drawPixel(i%8,i/8,0xF305);
    }else if (slide[i]==4){
      matrix.drawPixel(i%8,i/8,0x90FF);
    }else if (slide[i]==5){
      matrix.drawPixel(i%8,i/8,0xFFFF);
    }else if (slide[i]==6){
      matrix.drawPixel(i%8,i/8,0xF30F);
    }else if (slide[i]==7){
      matrix.drawPixel(i%8,i/8,0x6305);
    }else if (slide[i]==8){
      matrix.drawPixel(i%8,i/8,0xF005);
    }else if (slide[i]==9){
      matrix.drawPixel(i%8,i/8,0xF00F);
    }else if (slide[i]<=-1){
      matrix.drawPixel(i%8,i/8,0x0F05);
    }
  }
  matrix.show();
};

int8_t checkSpace(int8_t x,int8_t y,int8_t place,int8_t type){
  if (screen[x+8*y+place]<=-1){
    level=(screen[x+8*y+place])*(-1);
    newScreen(level);
  }else if(screen[x+8*y+place]==7){
    menu=menu+1;
    level=0;
    newScreen(level);
  }else{
    screen[x+8*y]=0;
    if (((x==0)and(place==-1))or((x==7)and(place==1))or((y==0)and(place==-8))or((y==7)and(place==8))){
      pos=findSpace(8);
      oldpos=x+8*y;
      x=pos%8;
      y=pos/8;
    }
    if ((screen[x+8*y+place]==3)or(screen[x+8*y+place]==6)){
      temp=checkSpace((x+8*y+place)%8,(x+8*y+place)/8,place,3);
    }else if ((screen[x+8*y+place]==8)or(screen[x+8*y+place]==9)){
      temp=checkSpace((x+8*y+place)%8,(x+8*y+place)/8,place,8);
    }
    if ((temp==2)and!(oldpos==0)){
      x=oldpos%8;
      y=oldpos/8;
    }
    if (screen[x+8*y+place]==2){
      temp=2;
    }else if (temp==2){
      if (screen[x+8*y+place]==8){
        temp=0;
        if (place==1){
          if (screen[32]==2){
            temp=2;
          }
        }else if (place==8){
          if (screen[4]==2){
            temp=2;
          }
        }else if (place==-1){
          if (screen[39]==2){
            temp=2;
          }
        }else if (place==-8){
          if (screen[60]==2){
            temp=2;
          }
        }
        if (temp==2){
        }else {
          if (place==1){
            x=-1;
            y=4;
          }else if (place==8){
            x=4;
            y=-1;
          }else if (place==-1){
            x=8;
            y=4;
          }else if (place==-8){
            x=4;
            y=8;
          }
          if ((screen[x+8*y+place]==3)or(screen[x+8*y+place]==6)){
            temp=checkSpace((x+8*y+place)%8,(x+8*y+place)/8,place,3);
          }else if ((screen[x+8*y+place]==8)or(screen[x+8*y+place]==9)){
            temp=checkSpace((x+8*y+place)%8,(x+8*y+place)/8,place,8);
          }
          if (temp==2){
          }else if (place==1){
            x+=1;
          }else if (place==8){
            y+=1;
          }else if (place==-1){
            x-=1;
          }else if (place==-8){
            y-=1;
          }
        }
      }
    }else if (place==1){
      x+=1;
    }else if (place==8){
      y+=1;
    }else if (place==-1){
      x-=1;
    }else if (place==-8){
      y-=1;
    }
    pos=findSpace(8);
    if (x<0){
      x=pos%8-1;
      y=pos/8;
    }else if (x>8){
      x=pos%8+1;
      y=pos/8;
    }else if (y<0){
      x=pos%8;
      y=pos/8-1;
    }else if (y>8){
      x=pos%8;
      y=pos/8+1;
    }
    screen[x+8*y]=type;
    return temp; 
  }
};

int8_t checkWin(int8_t slide[]){
  goal=0;
  for (int i=0;i<64;i++){
    if ((slide[i]==4)or(slide[i]==5)){
      goal=goal+1;
    }
  }
  if (goal==0){
    win[level-1]=1;
    goal=1;
    for (int i=0;i<check[menu];i++){
      if (win[i]==0){
        goal=0;
      }
    }
    if (goal==1){
      menus[menu][59]=7;
      menus[menu][60]=7;
    }
    level=0;
    newScreen(level);
    matrix.show();
  }
};

void drawRGBBitmap(int16_t x, int16_t y, const uint16_t *bitmap, int16_t w, int16_t h);

void setup() {
  pinMode(right, INPUT);
  pinMode(up, INPUT);
  pinMode(left, INPUT);
  pinMode(down, INPUT);
  matrix.begin();
  matrix.setRotation(1);  // You can set a value of 0-3 to change the rotation of the screen.
  matrix.setTextWrap(false);
  matrix.setBrightness(20);
  newScreen(0);
  printScreen(screen);
}

void loop() {
  if (digitalRead(right)==0){
    place=1;
  }else if(digitalRead(up)==0){
    if (digitalRead(left)==0){
      level=0;
      newScreen(level);
      printScreen(screen);
    }else{
      place=8;
    }
  }else if(digitalRead(left)==0){
    place=-1;
  }else if(digitalRead(down)==0){
    place=-8;
  }else{
    place=0;
  }
  if (not(place==0)){
    temp=0;
    while (temp>=0){
      if ((screen[temp]==1)or(screen[temp]==4)){
        x=temp%8;
        y=temp/8;
        temp=-1;
      }else{
        temp+=1;
      }
    }
    oldpos=0;
    checkSpace(x,y,place,1);
    printScreen(screen);
    if (level>=1){
      checkWin(screen);
    }
    delay(200);
  }
}
